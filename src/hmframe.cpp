/*
 *  hmframe.cpp is part of the HB-RF-ETH firmware v2.0
 *
 *  Original work Copyright 2022 Alexander Reinert
 *  https://github.com/alexreinert/HB-RF-ETH
 *
 *  Modified work Copyright 2025 Xerolux
 *  Modernized fork - Updated to ESP-IDF 5.1 and modern toolchains
 *
 *  The HB-RF-ETH firmware is licensed under a
 *  Creative Commons Attribution-NonCommercial-ShareAlike 4.0 International License.
 *
 *  You should have received a copy of the license along with this
 *  work.  If not, see <http://creativecommons.org/licenses/by-nc-sa/4.0/>.
 *
 *  Unless required by applicable law or agreed to in writing, software
 *  distributed under the License is distributed on an "AS IS" BASIS,
 *  WITHOUT WARRANTIES OR CONDITIONS OF ANY KIND, either express or implied.
 *  See the License for the specific language governing permissions and
 *  limitations under the License.
 *
 */

#include "hmframe.h"
#include <string.h>

// CRC16 lookup table for polynomial 0x8005
static const uint16_t crc16_table[256] = {
    0x0000, 0x8005, 0x800F, 0x000A, 0x801B, 0x001E, 0x0014, 0x8011,
    0x8033, 0x0036, 0x003C, 0x8039, 0x0028, 0x802D, 0x8027, 0x0022,
    0x8063, 0x0066, 0x006C, 0x8069, 0x0078, 0x807D, 0x8077, 0x0072,
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    0x8213, 0x0216, 0x021C, 0x8219, 0x0208, 0x820D, 0x8207, 0x0202
};

uint16_t HMFrame::crc(unsigned char *buffer, uint16_t len)
{
    uint16_t crc = 0xd77f;
    while (len--)
    {
        crc = (crc << 8) ^ crc16_table[((crc >> 8) ^ *buffer++) & 0xFF];
    }
    return crc;
}

bool HMFrame::TryParse(unsigned char *buffer, uint16_t len, HMFrame *frame)
{
    uint16_t crc;

    if (len < 8)
        return false;

    if (buffer[0] != 0xfd)
        return false;

    frame->data_len = ((buffer[1] << 8) | buffer[2]) - 3;
    if (frame->data_len + 8 != len)
        return false;

    crc = (buffer[len - 2] << 8) | buffer[len - 1];
    if (crc != HMFrame::crc(buffer, len - 2))
        return false;

    frame->destination = buffer[3];
    frame->counter = buffer[4];
    frame->command = buffer[5];
    frame->data = &buffer[6];

    return true;
}

HMFrame::HMFrame() : counter(0), destination(0), command(0), data(nullptr), data_len(0)
{
}

uint16_t HMFrame::encode(unsigned char *buffer, uint16_t len, bool escaped)
{
    uint16_t crc;

    if (data_len + 8 > len)
        return 0;

    buffer[0] = 0xfd;
    buffer[1] = ((data_len + 3) >> 8) & 0xff;
    buffer[2] = (data_len + 3) & 0xff;
    buffer[3] = destination;
    buffer[4] = counter;
    buffer[5] = command;
    if (data_len > 0)
        memcpy(&(buffer[6]), data, data_len);

    crc = HMFrame::crc(buffer, data_len + 6);
    buffer[data_len + 6] = (crc >> 8) & 0xff;
    buffer[data_len + 7] = crc & 0xff;

    uint16_t res = data_len + 8;

    if (escaped)
    {
        for (uint16_t i = 1; i < res; i++)
        {
            if (buffer[i] == 0xfc || buffer[i] == 0xfd)
            {
                memmove(buffer + i + 1, buffer + i, res - i);
                buffer[i++] = 0xfc;
                buffer[i] &= 0x7f;
                res++;
            }
        }
    }

    return res;
}
